## boards/shields/cornechon/Kconfig.defconfig
```kconfig
if SHIELD_CORNECHON_CENTRAL_DONGLE || SHIELD_CORNECHON_CENTRAL_LEFT

config ZMK_KEYBOARD_NAME
    default "Cornechon"

config ZMK_SPLIT_ROLE_CENTRAL
    default y

config ZMK_USB
    default y

endif

if SHIELD_CORNECHON_CENTRAL_DONGLE || SHIELD_CORNECHON_CENTRAL_LEFT || SHIELD_CORNECHON_PERIPHERAL_LEFT || SHIELD_CORNECHON_PERIPHERAL_RIGHT

config ZMK_SPLIT
    default y

endif
```

## boards/shields/cornechon/Kconfig.shield
```kconfig
config SHIELD_CORNECHON_CENTRAL_DONGLE
    def_bool $(shields_list_contains,cornechon_central_dongle)

config SHIELD_CORNECHON_CENTRAL_LEFT
    def_bool $(shields_list_contains,cornechon_central_left)

config SHIELD_CORNECHON_PERIPHERAL_LEFT
    def_bool $(shields_list_contains,cornechon_peripheral_left)

config SHIELD_CORNECHON_PERIPHERAL_RIGHT
    def_bool $(shields_list_contains,cornechon_peripheral_right)
```
